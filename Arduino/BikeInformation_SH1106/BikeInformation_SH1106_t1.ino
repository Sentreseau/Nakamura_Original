#include <TinyGPS++.h>
#include <SoftwareSerial.h>
#include <U8glib.h>
U8GLIB_SH1106_128X64 u8g(11, 10, 8, 9);  // SW SPI Com: CLK = 11, MOSI = 10, CS = 8, A0 = 9 ,RES = RST

// GPS側設定
// D2にTXD
// D3にRXD
TinyGPSPlus gps;
SoftwareSerial mySerial(2, 3);

// 表示用変数宣言
String TIM,LATR,LNGR,LAT,LNG,ALT,SPD,SAT;

// 画面描画フレームwait（msec）
// あんまり短すぎるとGPS信号取得処理が上手くいかなくなる
// 750
int framewait = 750;

// 計算用変数宣言
unsigned long timh;

// Hondaロゴマーク（スタートアップ時に表示）
const uint8_t honda_bitmap[] PROGMEM = {
0x0,0x0,0x0,0x0,0x4,0x0,0x0,0x0,0x0,0x0,0x0,0x0,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0x0,
0x0,0x0,0x0,0x0,0x3f,0x1,0xfe,0xf,0x0,0x0,0x0,0x0,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0x0,
0x0,0x0,0x0,0x0,0xe,0x30,0x0,0x70,0x81,0xfc,0x0,0x0,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0x0,
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0x0,0x3e,0xf,0xe0,0xc0,0x7f,0x3,0xc,0x4,0x7e,0xf,0xc1,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0x0
};


void setup(void) {
  Serial.begin(57600);
  while (!Serial) {
  ; // wait for serial port to connect. Needed for native USB port only
  }
  Serial.println("Goodnight moon!");

  // GPSモジュールとの通信は9600bpsで設定する
  mySerial.begin(9600);
  mySerial.println("Hello, world?");

  // flip screen, if required
  // u8g.setRot180();
  
  // set SPI backup if required
  //u8g.setHardwareBackup(u8g_backup_avr_spi);

  // assign default color value
  if ( u8g.getMode() == U8G_MODE_R3G3B2 ) {
    u8g.setColorIndex(255);     // white
  }
  else if ( u8g.getMode() == U8G_MODE_GRAY2BIT ) {
    u8g.setColorIndex(3);         // max intensity
  }
  else if ( u8g.getMode() == U8G_MODE_BW ) {
    u8g.setColorIndex(1);         // pixel on
  }
  else if ( u8g.getMode() == U8G_MODE_HICOLOR ) {
    u8g.setHiColorByRGB(255,255,255);
  }

  u8g.begin();
 // Hondaロゴマーク表示
  u8g.firstPage();  
  do {
    startup();
  } while( u8g.nextPage() );
  
  delay(5000);
}

void startup(void) {
  // graphic commands to redraw the complete screen should be placed here  
  u8g.drawBitmapP( 0, 0, 16, 64, honda_bitmap);
}

void gpsupdate(){
  while (mySerial.available() > 0){
    char c = mySerial.read();
    gps.encode(c);
  }
}

void timeupdate(){
if ((gps.time.hour()) >= 0 && (gps.time.hour()) <= 14){ 
      timh = (gps.time.hour()) + 9;
    } else {
      timh = (gps.time.hour()) - 15;
    }
    //時0埋め判定
    if (timh < 10){
      TIM = "0";
      TIM += String(timh); 
    } else {
      TIM = String(timh); 
    }
    //分0埋め判定
    if (gps.time.minute() < 10){
      TIM += ":0";
    } else {
      TIM += ":";
    }
    //秒0埋め判定
    TIM += String(gps.time.minute());
    if (gps.time.second() < 10){
      TIM += ":0";
    } else {
      TIM += ":";
    }
    TIM += String(gps.time.second());

}

void gpsparam_str(){
  LAT  =  String(gps.location.rawLat().negative ? "W" : "E");
  LAT  += String(gps.location.lat(),6);
  LNG  =  String(gps.location.rawLng().negative ? "S" : "N");
  LNG  += String(gps.location.lng(),6);
  ALT  =  String(gps.altitude.meters());
  ALT  += "m";
  SPD  =  String(gps.speed.kmph());
  SPD  += "km/h";
  SAT  =  String(gps.satellites.value());
}

void draw1(){
  //Serial.println("draw section");
  // フォント指定 
  //u8g.setFont(u8g_font_unifont);
  //u8g.setFont(u8g_font_osb21);
  //u8g.setFont(u8g_font_6x10);
  u8g.setFont(u8g_font_profont11r);
      
  //枠描画
  u8g.drawFrame(0,0,128,61);
  u8g.drawLine(0,10,128,10);
  u8g.drawLine(0,20,128,20);
  u8g.drawLine(0,30,128,30);
  u8g.drawLine(0,40,128,40);
  u8g.drawLine(0,50,128,50);
  u8g.drawLine(26,0,26,60);

  //ヘッダー文字
  u8g.drawStr(2,9, "TIME");
  u8g.drawStr(2,19,"LAT" );
  u8g.drawStr(2,29,"LONG");
  u8g.drawStr(2,39,"ALT" );
  u8g.drawStr(2,49,"SPD" );
  u8g.drawStr(2,59,"SAT" );
  
  //パラメータ
  u8g.setPrintPos(28,9 );u8g.print(TIM);
  u8g.setPrintPos(28,19);u8g.print(LAT);
  u8g.setPrintPos(28,29);u8g.print(LNG);
  u8g.setPrintPos(28,39);u8g.print(ALT);
  u8g.setPrintPos(28,49);u8g.print(SPD);
  u8g.setPrintPos(28,59);u8g.print(SAT);
}

void draw2(){
  u8g.setFont(u8g_font_profont11r);
  u8g.setPrintPos(0,0);u8g.print(SPD);
}


void GPSdraw(void) {
    // picture loop
      u8g.firstPage(); 
      do {
        draw1();
      } while( u8g.nextPage() );
  
      // rebuild the picture after some delay
      //delay(50); 
}

//実処理
void loop(void) {

  //GPS変数内のデータを更新
  gpsupdate();

  //取得したGPSデータを表示用にカスタマイズ
  if (gps.location.isUpdated()) {
    timeupdate();
    gpsparam_str();
  }
  
  //画面描画と他の処理を合わせるとデータ取得に支障がでるため分割
  //指定秒経過毎に描画する処理にする。
  static unsigned long time_oled = millis();
  if ((millis() - time_oled) > framewait){
      GPSdraw();
      time_oled = millis();
  }
  
  //debug
  Serial.print("TIME="); Serial.println(TIM);
  Serial.print("LAT="); Serial.println(LAT);
  Serial.print("LONG=");Serial.println(LNG);
  Serial.print("ALT="); Serial.println(ALT);
  Serial.print("SPD="); Serial.println(SPD);
  Serial.print("SAT="); Serial.println(SAT);
  
}




